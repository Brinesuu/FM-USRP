/**********************************
作者：单片机俱乐部
网站：https://www.mcuclub.cn/
**********************************/


/**********************************
包含头文件
**********************************/
#include "hc-sr04.h"


/*********************************************************
函数功能：毫秒级的延时函数，time是要延时的毫秒数
传入值：time:要延时的毫秒数
返回值：无
*********************************************************/
void Hcsr04_DelayMs(uint time)
{
	uint i,j;
	for(i=0;i<time;i++)
		for(j=0;j<112;j++);
}

/*********************************************************
函数功能：计算测到的距离
传入值：当前的环境温度
返回值：测得的距离(距离单位cm)
*********************************************************/
uint Hcsr04_GetDistance(uint Hcsr04_temp)
{
	uint distance;														// 用于记录测得的距离
	float gSpeed;															// 保存超声波的速度值

	gSpeed = 0.607*Hcsr04_temp+331.4;					// 根据公式 v=0.607T+331.4 计算出当前温度值对应的超声波速度，这时的单位是“米/秒” 
	gSpeed = gSpeed/10000;										// 将超声波的速度从单位“m/s”转为“cm/us”，方便后面的计算

	TH2 = 0;																	//如果使用了两个超声波距离传感器，则需要改成T1的HT1
	TL2 = 0;

	HCSR04_Trig = 1;													// 给超声波模块一个开始脉冲
	Hcsr04_DelayMs(1);
	HCSR04_Trig = 0;


	while(!HCSR04_Echo);											// 等待超声波模块的返回脉冲
	TR2 = 1;																	// 启动定时器，开始计时
	while(HCSR04_Echo);												// 等待超声波模块的返回脉冲结束
	TR2 = 0;																	// 停止定时器，停止计时

	distance=((TH2*256+TL2)*gSpeed)/2;				// 距离cm=（时间us * 速度cm/us）/2

	if(distance > 500)												// 把检测结果限制500厘米内
		distance = 500;
	
	return distance;
}

